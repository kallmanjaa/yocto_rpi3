## meta-rpi/conf/machine/rpi3.conf
```bitbake
#@TYPE: Machine
#@NAME: RPI3 
#@DESCRIPTION: Machine configuration for the RPi3 in 32 bit mode

DEFAULTTUNE ?= "cortexa7thf-neon-vfpv4"
require conf/machine/include/tune-cortexa7.inc
```
